/dts-v1/;
/plugin/;

/{
	compatible = "brcm,bcm2711";

	fragment@0 {
		target = <&i2c_arm>;
		__overlay__ {
			#address-cells = <1>;
			#size-cells = <0>;
			status = "okay";
			pca9554: pca9554@39 {
				compatible = "ti,pca9554";
				reg = <0x27>;
				gpio-controller;
				#gpio-cells = <0x02>;
			};
		};
	};

	fragment@1 {
		target = <&act_led>;
		frag1: __overlay__ {
			gpios = <&pca9554 0 0>;
		};
	};

	__overrides__ {
		addr = <&pca9554>,"reg:0";
		gpio = <&frag1>,"gpios:4";
		activelow = <&frag1>,"gpios:8";
	};
};
